## Kconfig
```kconfig
menu "Electro Library"

    config ELECTRO_STD_FORMAT
        bool "Enable std::format support"
        default y
        help
            Include <format> and provide std::formatter specializations
            for electro types. Disable if <format> is unavailable or
            undesired.

endmenu
```
